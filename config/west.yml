## config/west.yml
```yaml
manifest:
  version: 0.8
  projects:
    - name: ZMK Firmware
      url: https://github.com/zmkfirmware/zmk.git
      revision: main
      path: zmk
      # Dodaj inne repozytoria, które są potrzebne dla Twojego projektu
```
